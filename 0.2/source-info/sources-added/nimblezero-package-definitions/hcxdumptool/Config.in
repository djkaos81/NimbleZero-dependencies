## 0.2/source-info/sources-added/nimblezero-package-definitions/hcxdumptool/Config.in
```kconfig
config BR2_PACKAGE_HCXDUMPTOOL
	bool "hcxdumptool"
	select BR2_PACKAGE_LIBPCAP
	help
	  Capture Wi-Fi frames for security testing (needs a Wi-Fi
	  adapter with monitor mode; the built-in one has none).
	  Wanted by M5Stack apps (Debian: hcxdumptool).

	  https://github.com/ZerBea/hcxdumptool
```

## 0.2/source-info/sources-added/nimblezero-package-definitions/hcxtools/Config.in
```kconfig
config BR2_PACKAGE_HCXTOOLS
	bool "hcxtools"
	select BR2_PACKAGE_OPENSSL
	select BR2_PACKAGE_ZLIB
	select BR2_PACKAGE_LIBCURL
	help
	  Tools to convert Wi-Fi captures (pcapng) for hash crackers.
	  Wanted by M5Stack apps (Debian: hcxtools).

	  https://github.com/ZerBea/hcxtools
```

## 0.2/source-info/sources-added/nimblezero-package-definitions/libgme/Config.in
```kconfig
config BR2_PACKAGE_LIBGME
	bool "libgme (game-music-emu)"
	depends on BR2_INSTALL_LIBSTDCPP
	select BR2_PACKAGE_ZLIB
	help
	  Video game music emulation library: NES, SNES, Genesis/VGM,
	  Game Boy, PC Engine, MSX, ZX Spectrum, Atari.  Used by the
	  Media Player (package nz-lib-libgme).

	  https://github.com/libgme/game-music-emu

comment "libgme needs a toolchain w/ C++"
	depends on !BR2_INSTALL_LIBSTDCPP
```

## 0.2/source-info/sources-added/nimblezero-package-definitions/libsidplayfp/Config.in
```kconfig
config BR2_PACKAGE_LIBSIDPLAYFP
	bool "libsidplayfp"
	depends on BR2_INSTALL_LIBSTDCPP
	help
	  Commodore 64 SID music library.  Used by the Media Player
	  (package nz-lib-libsidplayfp).

	  https://github.com/libsidplayfp/libsidplayfp

comment "libsidplayfp needs a toolchain w/ C++"
	depends on !BR2_INSTALL_LIBSTDCPP
```

## 0.2/source-info/sources-added/nimblezero-package-definitions/nz-fonts-droid-fallback/Config.in
```kconfig
config BR2_PACKAGE_NZ_FONTS_DROID_FALLBACK
	bool "nz-fonts-droid-fallback (Droid Sans Fallback)"
	help
	  Droid Sans Fallback at the paths of Debian's fonts-droid-fallback.
```

## 0.2/source-info/sources-added/nimblezero-package-definitions/nz-fonts-noto-cjk/Config.in
```kconfig
config BR2_PACKAGE_NZ_FONTS_NOTO_CJK
	bool "nz-fonts-noto-cjk (Noto Sans CJK: regular, medium, bold)"
	help
	  Noto Sans CJK as the collection files that programs built for
	  Debian open by path (/usr/share/fonts/opentype/noto/). Regular
	  and Bold are byte-identical to Debian 13's fonts-noto-cjk;
	  Medium is in Debian's fonts-noto-cjk-extra. Serif and the other
	  weights are not shipped (owner decision 2026-11-22).
```

## 0.2/source-info/sources-added/nimblezero-package-definitions/nz-fonts-noto-color-emoji/Config.in
```kconfig
config BR2_PACKAGE_NZ_FONTS_NOTO_COLOR_EMOJI
	bool "nz-fonts-noto-color-emoji"
	help
	  Noto Color Emoji at Debian's path
	  (/usr/share/fonts/truetype/noto/NotoColorEmoji.ttf), which
	  M5Stack apps open.  The font file of Debian 13's package
	  fonts-noto-color-emoji 2.051 (SIL Open Font License 1.1).
```

## 0.2/source-info/sources-added/nimblezero-package-definitions/nz-pipewire-conf/Config.in
```kconfig
config BR2_PACKAGE_NZ_PIPEWIRE_CONF
	bool "nz-pipewire-conf (start-up and settings for PipeWire on NimbleZero)"
	depends on BR2_PACKAGE_PIPEWIRE && BR2_PACKAGE_WIREPLUMBER
	help
	  Start script and settings that run PipeWire, WirePlumber and the
	  PulseAudio-compatible service as user zero without a login
	  session. Part of the installable package nz-pipewire.
```

## 0.2/source-info/sources-added/nimblezero-package-definitions/nz-pygame/Config.in
```kconfig
config BR2_PACKAGE_NZ_PYGAME
	bool "nz-pygame (pygame 2.6.1)"
	depends on BR2_PACKAGE_PYTHON3
	select BR2_PACKAGE_SDL2
	select BR2_PACKAGE_SDL2_IMAGE
	select BR2_PACKAGE_SDL2_MIXER
	select BR2_PACKAGE_SDL2_TTF
	select BR2_PACKAGE_FREETYPE
	select BR2_PACKAGE_LIBPNG
	select BR2_PACKAGE_JPEG
	help
	  pygame (the version of Debian 13), built against SDL2.

	  https://www.pygame.org/
```

## 0.2/source-info/sources-added/nimblezero-package-definitions/nz-python-gpiozero/Config.in
```kconfig
config BR2_PACKAGE_NZ_PYTHON_GPIOZERO
	bool "nz-python-gpiozero"
	depends on BR2_PACKAGE_PYTHON3
	select BR2_PACKAGE_PYTHON_COLORZERO
	help
	  gpiozero for aarch64 (Buildroot's python-gpiozero is for 32-bit arm only).
```

## 0.2/source-info/sources-added/nimblezero-package-definitions/nz-system-font/Config.in
```kconfig
config BR2_PACKAGE_NZ_SYSTEM_FONT
	bool "nz-system-font (text font of the NimbleZero screens)"
	help
	  The font file /usr/share/nz/fonts/nz-8.nzf that nzui.h draws
	  all text with: NimbleZero Sans 8 (Latin, Greek, Cyrillic,
	  converted from Press Start 2P), the NimbleZero key symbols,
	  and Fusion Pixel 8px for Chinese, Japanese and Korean in its
	  four forms.  Both fonts are under the SIL Open Font License.
```

## 0.2/source-info/sources-added/nimblezero-package-definitions/python-libarchive-c/Config.in
```kconfig
config BR2_PACKAGE_PYTHON_LIBARCHIVE_C
	bool "python-libarchive-c"
	depends on BR2_PACKAGE_PYTHON3
	select BR2_PACKAGE_LIBARCHIVE
	help
	  Python interface to libarchive (for picamera2).
```

## 0.2/source-info/sources-added/nimblezero-package-definitions/python-picamera2/Config.in
```kconfig
config BR2_PACKAGE_PYTHON_PICAMERA2
	bool "python-picamera2"
	depends on BR2_PACKAGE_PYTHON3
	select BR2_PACKAGE_LIBCAMERA
	select BR2_PACKAGE_LIBCAMERA_PYTHON
	select BR2_PACKAGE_PYTHON_NUMPY
	select BR2_PACKAGE_PYTHON_PILLOW
	select BR2_PACKAGE_PYTHON_PIEXIF
	select BR2_PACKAGE_PYTHON_PIDNG
	select BR2_PACKAGE_PYTHON_SIMPLEJPEG
	select BR2_PACKAGE_PYTHON_VIDEODEV2
	select BR2_PACKAGE_PYTHON_PRCTL
	select BR2_PACKAGE_PYTHON_LIBARCHIVE_C
	select BR2_PACKAGE_PYTHON_TQDM
	select BR2_PACKAGE_PYTHON_JSONSCHEMA
	help
	  Raspberry Pi camera library for Python. Without PyAV (libav encoders) and OpenEXR (IMX500 only).
```

## 0.2/source-info/sources-added/nimblezero-package-definitions/python-pidng/Config.in
```kconfig
config BR2_PACKAGE_PYTHON_PIDNG
	bool "python-pidng"
	depends on BR2_PACKAGE_PYTHON3
	select BR2_PACKAGE_PYTHON_NUMPY
	help
	  DNG raw image writer (for picamera2).
```

## 0.2/source-info/sources-added/nimblezero-package-definitions/python-prctl/Config.in
```kconfig
config BR2_PACKAGE_PYTHON_PRCTL
	bool "python-prctl"
	depends on BR2_PACKAGE_PYTHON3
	select BR2_PACKAGE_LIBCAP
	help
	  Control process attributes through prctl (for picamera2).
```

## 0.2/source-info/sources-added/nimblezero-package-definitions/python-pypinyin/Config.in
```kconfig
config BR2_PACKAGE_PYTHON_PYPINYIN
	bool "python-pypinyin"
	depends on BR2_PACKAGE_PYTHON3

	help
	  Chinese characters to pinyin (Debian: python3-pypinyin).
```

## 0.2/source-info/sources-added/nimblezero-package-definitions/python-simplejpeg/Config.in
```kconfig
config BR2_PACKAGE_PYTHON_SIMPLEJPEG
	bool "python-simplejpeg"
	depends on BR2_PACKAGE_PYTHON3
	select BR2_PACKAGE_PYTHON_NUMPY
	select BR2_PACKAGE_JPEG
	help
	  Fast JPEG encoding and decoding with libjpeg-turbo (for picamera2).
```

## 0.2/source-info/sources-added/nimblezero-package-definitions/python-videodev2/Config.in
```kconfig
config BR2_PACKAGE_PYTHON_VIDEODEV2
	bool "python-videodev2"
	depends on BR2_PACKAGE_PYTHON3

	help
	  Python bindings for the V4L2 API (for picamera2).
```

## 0.2/source-info/sources-added/nimblezero-package-definitions/python-yt-dlp/Config.in
```kconfig
config BR2_PACKAGE_PYTHON_YT_DLP
	bool "python-yt-dlp"
	depends on BR2_PACKAGE_PYTHON3

	help
	  Video downloader (Debian: yt-dlp).
```
